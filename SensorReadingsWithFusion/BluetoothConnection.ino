#include <ArduinoBLE.h>

String mockdata = "1,-50.45,-2.09,77.36\
2,-19.03,53.13,175.6\
3,164.83,-49.06,-33.26\
4,152.43,81.6,-132.43\
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999,54.4,-53.98,-170.98\
1000,-128.21,-63.7,11.14";

String sensorServiceUUID = "580F";
BLEService sensorService(sensorServiceUUID);

// Need 2 characteristics, comand and data
BLEStringCharacteristic commandChar(sensorServiceUUID, BLERead | BLEWrite, 100);
BLEStringCharacteristic dataChar(sensorServiceUUID, BLERead | BLENotify, 50);

void setup(){
  Serial.begin(115200);
  while(!Serial);

  pinMode(LED_BUILTIN, OUTPUT);

  if(!BLE.begin()){
    Serial.println("Starting BLE module failed!");
    while(1);
  }

  BLE.setLocalName("TheraTec Sensor");
  BLE.setAdvertisedService(sensorService);
  sensorService.addCharacteristic(commandChar);
  sensorService.addCharacteristic(dataChar);
  BLE.addService(sensorService);

  Serial.println("Ready!");
  commandChar.setValue("Ready!");
  Serial.println(mockdata);
}

void loop(){
  BLEDevice central = BLE.central();
  while(!central);

  Serial.print("Connected to central: ");
  Serial.println(central.address());
  while(central.connected()){
    if(commandChar.written()){
      String command = commandChar.value();
      Serial.print("Recieved command: ");
      Serial.println(command);

      // uses the first char in command string
      switch(command[0]){
        case 's':
          // start recording data
          Serial.println("start recording session");
        case 'x':
          // stop recording session
          Serial.println("stop recording session");
        case 'g':
          // send session data over dataChar
          Serial.println("send session data");
      }
    }
  }
}

void sendSessionData(){
  // need to notify central when new data is available

}